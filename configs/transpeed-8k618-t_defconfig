## configs/transpeed-8k618-t_defconfig
```kconfig
CONFIG_ARM=y
CONFIG_ARCH_SUNXI=y
CONFIG_DEFAULT_DEVICE_TREE="allwinner/sun50i-h618-transpeed-8k618-t"
CONFIG_SPL=y
CONFIG_SUNXI_DRAM_H616_DDR3_1333=y
CONFIG_DRAM_CLK=648
CONFIG_DRAM_ODT_EN=y
CONFIG_DRAM_SUNXI_UNKNOWN_FEATURE=y
CONFIG_DRAM_SUNXI_BIT_DELAY_COMPENSATION=y
CONFIG_DRAM_SUNXI_READ_CALIBRATION=y
CONFIG_DRAM_SUNXI_DX_ODT=0x03030303
CONFIG_DRAM_SUNXI_DX_DRI=0x0e0e0e0e
CONFIG_DRAM_SUNXI_CA_DRI=0x00001f12
CONFIG_DRAM_SUNXI_ODT_EN=0x00000001
CONFIG_DRAM_SUNXI_TPR0=0xc0001002
CONFIG_DRAM_SUNXI_TPR2=0x00000000
CONFIG_DRAM_SUNXI_TPR10=0x002f1107
CONFIG_DRAM_SUNXI_TPR11=0xddddcccc
CONFIG_DRAM_SUNXI_TPR12=0xeddc7665
CONFIG_MACH_SUN50I_H616=y
CONFIG_R_I2C_ENABLE=y
CONFIG_SPL_I2C=y
CONFIG_SPL_I2C_SUPPORT=y
CONFIG_SPL_SYS_I2C_LEGACY=y
CONFIG_SYS_I2C_MVTWSI=y
CONFIG_SYS_I2C_SLAVE=0x7f
CONFIG_SYS_I2C_SPEED=100000
CONFIG_PHY_REALTEK=y
CONFIG_SUN8I_EMAC=y
CONFIG_I2C3_ENABLE=y
CONFIG_AXP313_POWER=y
CONFIG_USB_EHCI_HCD=y
CONFIG_USB_OHCI_HCD=y
CONFIG_USB_MUSB_GADGET=y
CONFIG_AXP_DCDC3_VOLT=1500
CONFIG_SUPPORT_EMMC_BOOT=y
CONFIG_SYS_MMCSD_RAW_MODE_U_BOOT_SECTOR=0x40
CONFIG_MMC_SUNXI_SLOT_EXTRA=2
CONFIG_OF_LIBFDT_OVERLAY=y
```
